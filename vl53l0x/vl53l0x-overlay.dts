/dts-v1/;
/plugin/;

#include <dt-bindings/gpio/gpio.h>

/ {
    compatible = "brcm,bcm2711";

    fragment@0 {
        target = <&i2c1>;
        __overlay__ {
            status = "okay";
            #address-cells = <1>;
            #size-cells = <0>;

            vl53l0x@29 {
                compatible = "opensource,vl53l0x-simple";
                reg = <0x29>;

                // Optional reset/powerdown (XSHUT, active-low). Example: GPIO17
                // xshutdown-gpios = <&gpio 17 GPIO_ACTIVE_LOW>;

                // Optional interrupt line (GPIO1). Example: GPIO27, level low
                // interrupts-extended = <&gpio 27 0>;
            };
        };
    };
};
