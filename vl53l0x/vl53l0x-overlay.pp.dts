/dts-v1/;
/plugin/;
/ {
    compatible = "brcm,bcm2711";
    fragment@0 {
        target = <&i2c1>;
        __overlay__ {
            status = "okay";
            #address-cells = <1>;
            #size-cells = <0>;
            vl53l0x@29 {
                compatible = "opensource,vl53l0x-simple";
                reg = <0x29>;
            };
        };
    };
};
